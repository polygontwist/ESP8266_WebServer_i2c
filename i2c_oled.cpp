/*
  
*/
#include "Arduino.h"
#include <Wire.h>

//#include <i2c.h>

#include "i2c_oled.h"
//#include "gpio.h"
//#include "ets_sys.h"
//#include "osapi.h"


  // Wire.begin(_devid);
  

  
unsigned char oled_Font[][8]={
{0x00,0x00,0x00,0x00,0x00,0x00,0x00,0x00},//space  32=0
{0x00,0x00,0x5F,0x00,0x00,0x00,0x00,0x00},//!
{0x00,0x00,0x07,0x00,0x07,0x00,0x00,0x00},//"
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{0x00,0x00,0x02,0x05,0x05,0x02,0x00,0x00}, //°	95

//animirtes funkICONS
{0b11000000,0b11000000,0b00000000,0b00000000,0b00000000,0b00000000,0b00000000,0b00000000},//96
{0b11010000,0b11010000,0b00010000,0b11100000,0b00000000,0b00000000,0b00000000,0b00000000},
{0b11010100,0b11010100,0b00010100,0b11100100,0b00001000,0b11110000,0b00000000,0b00000000},
{0b11000101,0b11000101,0b00000101,0b00000101,0b00001001,0b11110010,0b00000100,0b11111000},
{0b11000001,0b11000001,0b00000001,0b00000001,0b00000001,0b00000010,0b00000100,0b11111000}, //100
//IP
{0b01000010,0b01111110,0b01000010,0b00000000,0b01111110,0b00010010,0b00001100,0b00000000}, //101 
//timer
//{0b00000000,0b00111000,0b01000101,0b01010111,0b01000101,0b00111000,0b00000000,0b00000000} //102 
  {0b00111000,0b01000100,0b10010010,0b10011110,0b10000010,0b01000100,0b00111000,0b00000000}

};
 
//64 / 8 * 128
static char oLEDbuffer[1024] = { 
	0x00, 0x00, 0x00, 0x00, 0x00, 0x00, 0x00, 0x00, 0x00, 0x00, 0x00, 0x00, 0x00, 0x00, 0x00, 0x00,//Zeile 0
	0x00, 0x00, 0x00, 0x00, 0x00, 0x00, 0x00, 0x00, 0x00, 0x00, 0x00, 0x00, 0x00, 0x00, 0x00, 0x00,
	0x00, 0x00, 0x00, 0x00, 0x00, 0x00, 0x00, 0x00, 0x00, 0x00, 0x00, 0x00, 0x00, 0x00, 0x00, 0x00,
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	0x00, 0x00, 0x00, 0x00, 0x00, 0x00, 0x00, 0x00, 0x00, 0x00, 0x00, 0x00, 0x00, 0x00, 0x00, 0x00
};

//Aktuelle Position von setXY
int posX=0;//0..127 ...1023
int posY=0;//0..7

//write->parallel alles in Puffer schreiben
void i2c_oled::drawBuff(char data){
	int pos=posX+posY;// /8
	if(pos<1024)
		oLEDbuffer[pos]=data;
		else{
			Serial.print("--over-- ");
			Serial.println(pos);
		}
	posX++;//0..127
}
void i2c_oled::getBuff(void){
	int i;
	for(i=0;i<1024;i++){
		Serial.print(String(oLEDbuffer[i],DEC));
		Serial.print(" ");
	}
	Serial.println(" ");
}


void i2c_oled::drawPixel(int x, int y, int mode)
{
	if( (x>=width) || (x<0) ||(y>=height) || (y<0) ) return;

	int pos=0;
	int data=0;
	
	int xx=x/8;
	int yy=y/8;
	int restX=x-xx*8;
	int restY=y-yy*8;
	
	setXY(yy, xx);//zeile(0..7),spalte(0..15)
	
	Wire.beginTransmission(_devid); // begin transmitting
	Wire.write(0x40);//data mode ->8byte ->8x8bit
	for(int i=0;i<8;i++){ //8byte
		pos=posX+posY;// /8
		data=oLEDbuffer[pos];
		if(i==restX){
			switch (mode) {
				case drawmode_WHITE:	data |=  bit(restY); break;	//OR data = data | bit(restY)
				case drawmode_BLACK: 	data &= ~(bit(restY)); break;//invertirt + AND
				case drawmode_INVERSE:	data ^= bit(restY); break;	//XOR
			}
		}
		Wire.write(data);
		drawBuff(data);
	}
	Wire.endTransmission();    // stop transmitting	
}



void i2c_oled::drawLine(int xa, int ya,int xe, int ye, int mode)
{
 
  int16_t steep = abs(ye - ya) > abs(xe - xa);
  if (steep) {
    swap(xa, ya);
    swap(xe, ye);
  }

  if (xa > xe) {
    swap(xa, xe);
    swap(ya, ye);
  }

  int16_t dx, dy;
  dx = xe - xa;
  dy = abs(ye - ya);

  int16_t err = dx / 2;
  int16_t ystep;

  if (ya < ye) {
    ystep = 1;
  } else {
    ystep = -1;
  }
  for (; xa<=xe; xa++) {
    if (steep) {
      drawPixel(ya, xa, mode);
    } else {
      drawPixel(xa, ya, mode);
    }

    err -= dy;
    if (err < 0) {
      ya += ystep;
      err += dx;
    }
  }  
}


void i2c_oled::drawRect(int x, int y,int b, int h, int mode)
{
	drawLine(x,y,x+b,y,mode);
	drawLine(x+b,y,x+b,y+h,mode);
	drawLine(x,y+h,x+b,y+h,mode);
	drawLine(x,y,x,y+h,mode);
}

i2c_oled::i2c_oled()
{
	//	pin 2  gpio2  SDA (data)	pin 0  gpio1  SCL (clock) 
	// Wire.pins(0, 2); //0=SDA, 2=SCL
}

void i2c_oled::init(int i2c_devid=OLED_DEVID)
{
  _devid=i2c_devid; 
  init_OLED();
}


void i2c_oled::invert_display(bool inv)
{
  if(inv){
	sendcommand(0xA7);//INVERTDISPLAY 
  }
  else{
	sendcommand(0xA6);//NORMALDISPLAY 
  }
}

void i2c_oled::reset_display(void)
{
  displayOff();
  clear_display();

  displayOn();
}
//==========================================================//
// Turns display on.
void i2c_oled::displayOn(void)
{
    sendcommand(0xaf);        //display on
}
//==========================================================//
// Turns display off.
void i2c_oled::displayOff(void)
{
  sendcommand(0xae);		//display off
}
//==========================================================//
// Clears the display by sendind 0 to all the screen map.
void i2c_oled::clear_display(void)
{
  unsigned char i,k;
  for(k=0;k<8;k++)  //8
  {	
    setXY(k,0);    //Zeile
    {
      for(i=0;i<128;i++)     //spalte
      {
        SendChar(0);         //clear all COL
      }
    }
  }
}
//==========================================================//
// Actually this sends a byte, not a char to draw in the display. 
// Display's chars uses 8 byte font the small ones and 96 bytes
// for the big number font.
void i2c_oled::SendChar(unsigned char data) 
{ 
  Wire.beginTransmission(_devid); // begin transmitting
  Wire.write(0x40);//data mode
  Wire.write(data);
  drawBuff(data);
  Wire.endTransmission();    // stop transmitting
}
//==========================================================//
// Set the cursor position in a 16 COL * 8 ROW map.
void i2c_oled::setXY(unsigned char zeile,unsigned char spalte)  //zeile(je 8bit hoch), spalte(0..127)
{
  sendcommand(0xb0+zeile);                //set page address
  sendcommand(0x00+(8*spalte&0x0f));       //set low col address  //8
  sendcommand(0x10+((8*spalte>>4)&0x0f));  //set high col address  //8  
  
  posX=spalte*8;//Spalte
  posY=zeile*128;//Zeile/Page (je 8bit hoch)
 
}

//==========================================================//
// Prints a display char (not just a byte) in coordinates X Y,
// being multiples of 8. This means we have 16 COLS (0-15) 
// and 8 ROWS (0-7).
void i2c_oled::sendCharXY(unsigned char data, int zeile, int spalte)
{
  setXY(zeile, spalte);
  Wire.beginTransmission(_devid); // begin transmitting
  Wire.write(0x40);//data mode
  
  for(int i=0;i<8;i++){ //8 byte
     Wire.write(pgm_read_byte(oled_Font[data-0x20]+i));
	 drawBuff(pgm_read_byte(oled_Font[data-0x20]+i));
	}
    
  Wire.endTransmission();    // stop transmitting
}


//todo: Font 4x4 (scale)
/*
stretch x=  b0101 0101  --> b0011001100110011 -> b00110011 b00110011


*/


//==========================================================//
// Used to send commands to the display.
void i2c_oled::sendcommand(unsigned char com)
{
  Wire.beginTransmission(_devid);     //begin transmitting
  Wire.write(0x80);                          //command mode
  Wire.write(com);
  Wire.endTransmission();                    // stop transmitting
}



//==========================================================//
// Prints a string regardless the cursor position.
void i2c_oled::sendStr(unsigned char *string)
{
  unsigned char i=0;
  while(*string)
  {
    for(i=0;i<8;i++)  
    {
      SendChar(pgm_read_byte(oled_Font[*string-0x20]+i));
    }
    *string++;
  }
}
//==========================================================//
// Prints a string in coordinates X Y, being multiples of 8.
// This means we have 16 COLS (0-15) and 8 ROWS (0-7).
void i2c_oled::sendStrXY( char *string, int zeile, int spalte)
{
  setXY(zeile,spalte);
 /* Serial.println("sendStrXY=");
  Serial.println(string);*/
  unsigned char i=0;
  while(*string)
  {
    for(i=0;i<8;i++)  
    {
     SendChar(pgm_read_byte(oled_Font[*string-0x20]+i));
    }
    *string++;
  }
}

//==========================================================//
// Inits oled and draws logo at startup
void i2c_oled::init_OLED(void)
{
//  sendcommand(0xae);		//display off
//  sendcommand(0xa6);            //Set Normal Display (default) 
    // Adafruit Init sequence for 128x64 OLED module
    sendcommand(0xAE);             //DISPLAYOFF
    sendcommand(0xD5);            //SETDISPLAYCLOCKDIV
    sendcommand(0x80);            // the suggested ratio 0x80
    sendcommand(0xA8);            //SSD1306_SETMULTIPLEX
    //sendcommand(0x2F); //--1/48 duty    //NEW!!!
     sendcommand(0x3F); //ak - sonst fehlt die 1. Zeile!
    sendcommand(0xD3);            //SETDISPLAYOFFSET
    sendcommand(0x0);             //no offset
    sendcommand(0x40 | 0x0);      //SETSTARTLINE
    sendcommand(0x8D);            //CHARGEPUMP
    sendcommand(0x14);
    sendcommand(0x20);             //MEMORYMODE
    sendcommand(0x00);             //0x0 act like ks0108
    
    sendcommand(0xA0 | 0x1);      //SEGREMAP   //Rotate screen 180 deg
    //sendcommand(0xA0);
    
    sendcommand(0xC8);            //COMSCANDEC  Rotate screen 180 Deg
    //sendcommand(0xC0);
    
    sendcommand(0xDA);            //0xDA
    sendcommand(0x12);           //COMSCANDEC
    sendcommand(0x81);           //SETCONTRAST
    sendcommand(0xCF);           //
    sendcommand(0xd9);          //SETPRECHARGE 
    sendcommand(0xF1); 
    sendcommand(0xDB);        //SETVCOMDETECT                
    sendcommand(0x40);
    sendcommand(0xA4);        //DISPLAYALLON_RESUME        
    sendcommand(0xA6);        //NORMALDISPLAY             

//**
  clear_display();
  sendcommand(0x2e);            // stop scroll
  //----------------------------REVERSE comments----------------------------//
  //  sendcommand(0xa0);		//seg re-map 0->127(default)
  //  sendcommand(0xa1);		//seg re-map 127->0
  //  sendcommand(0xc8);
  //  delay(1000);
  //----------------------------REVERSE comments----------------------------//
  // sendcommand(0xa7);  //Set Inverse Display  
  // sendcommand(0xae);		//display off
  sendcommand(0x20);            //Set Memory Addressing Mode
  sendcommand(0x00);            //Set Memory Addressing Mode ab Horizontal addressing mode
  //  sendcommand(0x02);         // Set Memory Addressing Mode ab Page addressing mode(RESET)  
 
   setXY(0,0);
 //**
 
  /*
  for(int i=0;i<128*8;i++)     // show 128* 64 Logo
  {
    SendChar(pgm_read_byte(logo+i));
  }
  */
  sendcommand(0xaf);		//display on
}




